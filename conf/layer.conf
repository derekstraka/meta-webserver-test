## conf/layer.conf
```bitbake
# We have a conf and classes directory, append to BBPATH
BBPATH .= ":${LAYERDIR}"

# We have a recipes directory, add to BBFILES
BBFILES += "${LAYERDIR}/recipes-*/*/*.bb ${LAYERDIR}/recipes-*/*/*.bbappend"

BBFILE_COLLECTIONS += "meta-webserver-test"
BBFILE_PATTERN_meta-webserver-test := "^${LAYERDIR}/"
BBFILE_PRIORITY_meta-webserver-test = "7"

LAYERDEPENDS_{layername} = "core"
LAYERSERIES_COMPAT_{layername} = "{compat}"
```
